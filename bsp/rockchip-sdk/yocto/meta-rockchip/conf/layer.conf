## layers/meta-balena-rockchip/conf/layer.conf
```bitbake
BBPATH .= ":${LAYERDIR}"

BBFILES += "${LAYERDIR}/recipes-*/*/*.bb \
            ${LAYERDIR}/recipes-*/*/*.bbappend"

BBFILE_COLLECTIONS += "balena-rockchip"
BBFILE_PATTERN_balena-rockchip := "^${LAYERDIR}/"
BBFILE_PRIORITY_balena-rockchip = "1337"

LAYERDEPENDS_balena-rockchip = " \
    core \
    openembedded-layer \
    seeed-rockchip \
    balena-common \
    balena-wrynose \
    balena-rust \
"

LAYERSERIES_COMPAT_balena-rockchip = "wrynose"

MACHINE_ESSENTIAL_EXTRA_RDEPENDS:remove = "kernel-image"
KERNEL_IMAGETYPE = "Image"
BALENA_DISABLE_KERNEL_HEADERS = "1"
PREFERRED_PROVIDER_virtual/bootloader = "u-boot"
KERNEL_CLASSES = ""
```
